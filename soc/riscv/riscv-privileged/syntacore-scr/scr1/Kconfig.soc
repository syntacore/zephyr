## soc/riscv/riscv-privileged/syntacore-scr/scr1/Kconfig.soc
```kconfig
# Kconfig - RISCV32_SCR1 SoC configuration options
#
# Copyright (C) Syntacore 2017-2022. All rights reserved.
#
# SPDX-License-Identifier: Apache-2.0
#

choice
prompt "Syntacore SCR1-based SoC implementation"
depends on SOC_SERIES_RISCV32_SCR1

config SOC_RISCV32_SCR1
	bool "Syntacore SCR1-based SoC implementation"

config SOC_ELCT_SCU
    bool "ELCT SCU SoC implementation"
    select HAS_SPI_DW

endchoice
```

## soc/riscv/riscv-privileged/syntacore-scr/scr7/Kconfig.defconfig.series
```kconfig
if SOC_SERIES_RISCV64_SCR7

config SOC_SERIES
	string
	default "scr7"

config SYS_CLOCK_HW_CYCLES_PER_SEC
	int
	default 65000000

config RISCV_SOC_INTERRUPT_INIT
	bool
	default y

config RISCV_HAS_CPU_IDLE
	bool
	default y

config RISCV_HAS_PLIC
	bool
	default y
	
config MINIMAL_LIBC_OPTIMIZE_STRING_FOR_SIZE
	bool
	default n

config FPU
	bool "FPU unit"
	default y
	help
		This option enables Floating Point Unit

config CPU_HAS_FPU_DOUBLE_PRECISION
	bool "Double precision FPU"
	default y
	help
		This option enables Double Floating Point precision Unit

config FLOAT_HARD
	bool "Hard-float ABI"
	default y
	help
		This option enables HW Floating Point ABI

config 2ND_LVL_ISR_TBL_OFFSET
	default 12

config 2ND_LVL_INTR_00_OFFSET
	default 11

config MAX_IRQ_PER_AGGREGATOR
	default 4

config NUM_IRQS
	int
	default 128

config ICACHE_LINE_SIZE
	default 16

config DCACHE_LINE_SIZE
	default 16

config XIP
	bool
	default y

config SCR_MPU
	bool "Syntacore MPU"
	default y
	help
		This option enables Syntacore Memory Protection Unit

config SCR_L1_CACHE
	bool "Syntacore L1 cache"
	default y
	help
		This option enables Syntacore L1 cache

config SCR_L2_CACHE
	bool "Syntacore L2 cache"
	default y
	help
		This option enables Syntacore L2 cache

config CACHE_MANAGEMENT
	default y if SCR_L1_CACHE || SCR_L2_CACHE

endif # SOC_SERIES_RISCV64_SCR7
```

## soc/riscv/riscv-privileged/syntacore-scr/scr7/Kconfig.series
```kconfig
# Kconfig - SCR7 SoC implementation
#
# Copyright (C) Syntacore 2022-2023. All rights reserved.
#
# SPDX-License-Identifier: Apache-2.0
#

config SOC_SERIES_RISCV64_SCR7
	bool "SoC implementation based on SCR7"
	select RISCV
	select RISCV_GP
	select RISCV_ISA_RV64I
	select RISCV_ISA_EXT_M
	select RISCV_ISA_EXT_A
	select RISCV_ISA_EXT_C
	select RISCV_ISA_EXT_F
	select RISCV_ISA_EXT_D
	select RISCV_ISA_EXT_ZICSR
	select RISCV_ISA_EXT_ZIFENCEI
	select 64BIT
	select SOC_FAMILY_RISCV_PRIVILEGED
	select CPU_HAS_FPU_DOUBLE_PRECISION
	select SYNTACORE_SCR
	select CPU_HAS_DCACHE
	select CPU_HAS_ICACHE
	select SCR_L1_CACHE
	select SCR_L2_CACHE
	select RISCV_EARLY_INIT_SECONDARY if (MP_MAX_NUM_CPUS > 1)
	help
		Enable support for Syntacore SCR7-based SoC
```

## soc/riscv/riscv-privileged/syntacore-scr/scr7/Kconfig.soc
```kconfig
# Kconfig - SCR7 L2 SoC configuration options
#
# Copyright (C) Syntacore 2022-2023. All rights reserved.
#
# SPDX-License-Identifier: Apache-2.0
#

choice
prompt "SoC implementation based on SCR7"
depends on SOC_SERIES_RISCV64_SCR7

config SOC_RISCV64_SCR7_L2
	bool "SoC implementation based on Syntacore SCR7 L2 with PMP"

config SOC_RISCV64_SCR7_L2_MPU
	bool "SoC implementation based on Syntacore SCR7 L2 with MPU"
	select SCR_MPU

endchoice
```
