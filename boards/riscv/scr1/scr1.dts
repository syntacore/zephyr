/*
 * Copyright (c) 2023 Syntacore
 *
 * SPDX-License-Identifier: Apache-2.0
 */

/dts-v1/;

#include "syntacore/scr1.dtsi"

/ {
	model = "scr1";
	compatible = "scr,scr1";
	
	soc {
		tcm: memory@f0000000 {
			compatible = "zephyr,memory-region";
			reg = <0xf0000000 DT_SIZE_K(64)>;
			zephyr,memory-region = "TCM";
		};
	};

	chosen {
		zephyr,console = &uart0;
		/* Use TCM as SRAM by default */
		zephyr,sram = &tcm;
	};
};

