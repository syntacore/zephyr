## boards/riscv/vcu118_scr1/Kconfig.board
```kconfig
config BOARD_VCU118_SCR1
	bool "VCU118 FPGA scr1 target"
	depends on SOC_RISCV32_SCR1
```

## boards/riscv/vcu118_scr1/vcu118_scr1_defconfig
```kconfig
CONFIG_SOC_SERIES_RISCV32_SCR1=y
CONFIG_SOC_RISCV32_SCR1=y
CONFIG_BOARD_VCU118_SCR1=y
CONFIG_LINKER_SORT_BY_ALIGNMENT=n
CONFIG_XIP=n
CONFIG_INCLUDE_RESET_VECTOR=y
CONFIG_CONSOLE=y
CONFIG_PRINTK=y
CONFIG_SERIAL=y
CONFIG_UART_CONSOLE=y
CONFIG_BOOT_BANNER=y
```

## boards/riscv/vcu118_scr7/Kconfig.board
```kconfig
config BOARD_VCU118_SCR7
	bool "VCU118 FPGA scr7 target"
	depends on SOC_RISCV64_SCR7
```

## dts/bindings/cache/syntacore,cache.yaml
```yaml
description: Cache properties for Syntacore platforms

compatible: "syntacore,cache"

properties:
  d-cache-line-size:
    type: int
    required: true
    description: Data Cache line size

  d-cache-size:
    type: int
    required: true
    description: Data Cache size

  i-cache-line-size:
    type: int
    required: true
    description: Instruction Cache line size

  i-cache-size:
    type: int
    required: true
    description: Instruction Cache size
```

## dts/bindings/interrupt-controller/riscv,scr-ipic.yaml
```yaml
# Copyright (c) 2023, Syntacore
# SPDX-License-Identifier: Apache-2.0

description: RISC-V Syntacore CPU external interrupt controller

compatible: "riscv,scr-ipic"

include: [interrupt-controller.yaml, base.yaml]

properties:
  "#interrupt-cells":
    const: 1

interrupt-cells:
  - irq
```

## dts/bindings/mmu_mpu/scr,mpu.yaml
```yaml
description: Syntacore MPU (Memory Protection Unit)

compatible: "scr,mpu"

include: base.yaml

properties:
    reg:
      required: true

    num-mpu-regions:
      required: true
      type: int
      description: number of MPU regions supported by hardware
```

## dts/bindings/timer/scr,machine-timer.yaml
```yaml
# Copyright (c) Syntacore 2022. All rights reserved.

# SPDX-License-Identifier: Apache-2.0

description: |
  SCR Machine Timer

  The Syntacore machine timer provides RISC-V privileged mtime and mtimecmp
  registers.

compatible: "scr,machine-timer"

include: base.yaml

properties:
    reg:
      required: true

    interrupts:
      required: true
```
