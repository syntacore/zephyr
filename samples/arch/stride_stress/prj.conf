## CMakeLists.txt
```
# Copyright (C) 2023, Syntacore Ltd.
#
# Licensed under the Apache License, Version 2.0 (the "License");
# you may not use this file except in compliance with the License.
# You may obtain a copy of the License at
#     http://www.apache.org/licenses/LICENSE-2.0
# Unless required by applicable law or agreed to in writing, software
# distributed under the License is distributed on an "AS IS" BASIS,
# WITHOUT WARRANTIES OR CONDITIONS OF ANY KIND, either express or implied.
# See the License for the specific language governing permissions and
# limitations under the License.

cmake_minimum_required(VERSION 3.20.0)

find_package(Zephyr REQUIRED HINTS $ENV{ZEPHYR_BASE})
project(membarrier)

target_sources(app PRIVATE src/main.c)
target_sources(app PRIVATE src/modes.c)
```

## sample.yaml
```
# Copyright (C) 2023, Syntacore Ltd.
#
# Licensed under the Apache License, Version 2.0 (the "License");
# you may not use this file except in compliance with the License.
# You may obtain a copy of the License at
#     http://www.apache.org/licenses/LICENSE-2.0
# Unless required by applicable law or agreed to in writing, software
# distributed under the License is distributed on an "AS IS" BASIS,
# WITHOUT WARRANTIES OR CONDITIONS OF ANY KIND, either express or implied.
# See the License for the specific language governing permissions and
# limitations under the License.

sample:
  name: stride
tests:
  sample.arch.membarrier:
    harness: console
    tags: testing
  filter: CONFIG_UART_CONSOLE
```

## prj.conf
```kconfig
# Copyright (C) 2023, Syntacore Ltd.
#
# Licensed under the Apache License, Version 2.0 (the "License");
# you may not use this file except in compliance with the License.
# You may obtain a copy of the License at
#     http://www.apache.org/licenses/LICENSE-2.0
# Unless required by applicable law or agreed to in writing, software
# distributed under the License is distributed on an "AS IS" BASIS,
# WITHOUT WARRANTIES OR CONDITIONS OF ANY KIND, either express or implied.
# See the License for the specific language governing permissions and
# limitations under the License.

CONFIG_CONSOLE_SUBSYS=y
CONFIG_TEST=y
CONFIG_THREAD_STACK_INFO=y
CONFIG_TIMESLICING=y
CONFIG_TIMESLICE_SIZE=100
CONFIG_DEBUG=y
CONFIG_CRC=y
CONFIG_SMP=y
```

## src/main.c
```c
/*
 * Copyright (C) 2023, Syntacore Ltd.
 *
 * Licensed under the Apache License, Version 2.0 (the "License");
 * you may not use this file except in compliance with the License.
 * You may obtain a copy of the License at
 *     http://www.apache.org/licenses/LICENSE-2.0
 * Unless required by applicable law or agreed to in writing, software
 * distributed under the License is distributed on an "AS IS" BASIS,
 * WITHOUT WARRANTIES OR CONDITIONS OF ANY KIND, either express or implied.
 * See the License for the specific language governing permissions and
 * limitations under the License.
 */
/*
 * @file main.c
 *
 * @author vdsh-sc
 */

/******************************************************************************
 *                              Includes section
 */
#include <zephyr/kernel.h>
#include "modes.h"
#include <string.h>

/******************************************************************************
 *                              Static variables section
 */
static K_THREAD_STACK_ARRAY_DEFINE(tstack, NUM_THREADS, STACK_SIZE);
static k_tid_t tinfo[NUM_THREADS];
static struct k_thread tthread[NUM_THREADS];

static __aligned(sizeof(char*)) struct mem_raw test_array;
static struct k_mutex mutex_for_descr;
static size_t hash_errors[NUM_THREADS];
static size_t total_hash_errors;

/******************************************************************************
 *                              Prototypes section
 */
static void threads_init(void)
{
    memset(tthread, 0x00, sizeof(tthread));
    memset(tinfo, 0x00, sizeof(tinfo));
    memset(tstack, 0x00, sizeof(tstack));
}

/**
 * @brief Stride memory initialization
 */
static void stride_initialize(struct mem_descriptor* descriptor)
{   
    if (IS_ENABLED(CONFIG_DEBUG)) {
        printk("start: %p, end: %p\n", descriptor->raw_ptr, descriptor->raw_ptr + sizeof(struct mem_raw));
        printk("array start: %p, array size - 0x%lx\n", descriptor->start_ptr, descriptor->max_range);
    }
    size_t i;

    struct base_stride_struct* addr = (struct base_stride_struct*) descriptor->start_ptr;
    size_t stride = descriptor->stride;
    size_t range = descriptor->range;

    for (i = 1; i < range / stride; i++) {
        addr[i - 1].next = &addr[i];
    }

    addr[range / stride - 1].next = &addr[0];
}

/**
 * @brief Runs benchmark threads
 */
static void run_benchmark(struct mem_descriptor* descriptor)
{
    for (int i = 0; i < NUM_THREADS; i++) {
        tinfo[i] = k_thread_create(&tthread[i], tstack[i], STACK_SIZE, 
                        (k_thread_entry_t) thread_routine,
                        (void *) descriptor, &hash_errors[i], NULL,
                        K_PRIO_PREEMPT(10), 0, K_NO_WAIT);
    }
    for (int i = 0; i < NUM_THREADS; i++) {
        k_thread_join(tinfo[i], K_FOREVER);     
    }
}

/**
 * @brief Gives the next range (from lmbench)
 */
static size_t get_next_range(size_t k)
{
    if (k < 1024) {
        k = k * 2;
    } else if (k < 4*1024) {
        k += 1024;
    } else {
        size_t s;

        for (s = 32 * 1024; s <= k; s *= 2)
            ;
        k += s / 16;
    }
    return (k);
}

static void run_test(size_t max_range, size_t range, size_t stride, 
                    void (*action) (struct mem_descriptor* descriptor, size_t* hash_errors))
{
    struct mem_descriptor descriptor;

    if (range < stride) {
        return;
    }
    if (range > max_range) {
        return;
    }

    descriptor.range  = range;
    descriptor.max_range = max_range;
    descriptor.stride = stride;
    descriptor.mutex = &mutex_for_descr;
    descriptor.action = action;
    descriptor.raw_ptr = test_array.left_canary[0];
    descriptor.start_ptr = test_array.main_array;
    descriptor.iterations = ITERATIONS;

    if (IS_ENABLED(CONFIG_DEBUG)) {
        printk("max_range - %ld, range - %ld, stride - %ld\n", max_range, range, stride);
    }

    for (int i = 0; i < NUM_THREADS; i++) {
        hash_errors[i] = 0;
    }

    stride_initialize(&descriptor);
    run_benchmark(&descriptor);

    for (int i = 0; i < NUM_THREADS; i++) {
        total_hash_errors += hash_errors[i];
    }
}

int main(int ac, char **av)
{
    threads_init();

    k_mutex_init(&mutex_for_descr);

    size_t range;
    for (range = LOWER; range <= MAX_RANGE; range = get_next_range(range)) {
        printk("\nStart CLEAN with %ld range\n", range);
        run_test(MAX_RANGE, range, STRIDE, cache_lines_clean);
    }

    for (range = LOWER; range <= MAX_RANGE; range = get_next_range(range)) {
        printk("\nStart DIRTY with %ld range\n", range);
        run_test(MAX_RANGE, range, STRIDE, cache_lines_dirty);
    }

    if (IS_ENABLED(CONFIG_DEBUG)) {
        printk("Size of max_num_entries: %d, size of num_entries: %d\n", 
                                        MAX_RANGE / CACHE_LINE, NUM_ENTRIES);
    }
    
    if (total_hash_errors == 0) {
        printk("\nTEST PASSED, NO HASH ERRORS\n");
    } else {
        printk("\nTOTAL: %ld HASH ERRORS\n", total_hash_errors);
    }

    return 0;
}
```

## src/modes.c
```c
/*
 * Copyright (C) 2023, Syntacore Ltd.
 *
 * Licensed under the Apache License, Version 2.0 (the "License");
 * you may not use this file except in compliance with the License.
 * You may obtain a copy of the License at
 *     http://www.apache.org/licenses/LICENSE-2.0
 * Unless required by applicable law or agreed to in writing, software
 * distributed under the License is distributed on an "AS IS" BASIS,
 * WITHOUT WARRANTIES OR CONDITIONS OF ANY KIND, either express or implied.
 * See the License for the specific language governing permissions and
 * limitations under the License.
 */
/*
 * @file modes.c
 *
 * @author vdsh-sc
 */

/******************************************************************************
 *                              Includes section
 */
#include <zephyr/kernel.h>
#include "modes.h"
#include <zephyr/sys/crc.h>

/******************************************************************************
 *                              Prototypes section
 */

static void calc_crc(uint32_t* crc_result, struct region_crc* regions, int region_nums)
{
    for (int j = 0; j < region_nums; j++) {
        crc_result[j] = crc32_ieee_update(0, regions[j].ptr, regions[j].size);
    }
}

/**
 * @brief Reads from each memory location of size CACHE_LINE from range
 */
void cache_lines_clean(struct mem_descriptor* descriptor, size_t* hash_errors)
{
    size_t iterations = ITERATIONS;                 /* +1 becaues of count > 0 */
    size_t count = descriptor->range / (descriptor->stride * HUNDRED_TIMES) + 1;
    size_t i;
    char** volatile p = (char** volatile) descriptor->start_ptr;

    /* regions need to check memory integrity by crc. You can add more regions */

    struct region_crc regions[] = {
        {(const uint8_t *) descriptor->raw_ptr, sizeof(struct mem_raw)}
    };

    if (IS_ENABLED(CONFIG_DEBUG)) {
        for (int j = 0; j < ARRAY_SIZE(regions); j++) {
            printk("crc%d: start - %p, size - 0x%lx, end - %p\n", 
                j, regions[j].ptr, regions[j].size, regions[j].ptr + regions[j].size);
        }
    }

    uint32_t crc_before[ARRAY_SIZE(regions)];
    calc_crc(crc_before, regions, ARRAY_SIZE(regions));

    while (iterations-- > 0) {
        for (i = 0; i < count; ++i) {
            HUNDRED;        
        }
    }

    uint32_t crc_after[ARRAY_SIZE(regions)];
    calc_crc(crc_after, regions, ARRAY_SIZE(regions));

    if (IS_ENABLED(CONFIG_DEBUG)) {
        for (int j = 0; j < ARRAY_SIZE(regions); j++) {
            printk("[%d]: before - %d, after - %d, result: %u\n", 
                j, crc_before[j], crc_after[j], crc_before[j] == crc_after[j]);
        }
    }
    for (int j = 0; j < ARRAY_SIZE(regions); j++) {
        *hash_errors += (crc_before[j] != crc_after[j]);
    }
}

/**
 * @brief Pollute each base_stride_struct once
 */
static void pollute_arr_once(size_t poison, struct dirty_stride_struct* array_itr, size_t count) {

    for (int i = 0; i < count; ++i) {
        array_itr->poisoned = poison;
        array_itr = (struct dirty_stride_struct*) array_itr->next;
    }
}

/**
 * @brief We pollute the array first with a new value, and then pollute the previous 
 *        one - and the total hash from the array does not change
 */
static void touch_arr(size_t poison, struct dirty_stride_struct* array_itr, size_t count) {

    poison++;
    pollute_arr_once(poison, array_itr, count);
    poison--;
    pollute_arr_once(poison, array_itr, count);
}

/**
 * @brief Reads and writes to each memory location of size CACHE_LINE from range
 */
void cache_lines_dirty(struct mem_descriptor* descriptor, size_t* hash_errors)
{
    size_t iterations = descriptor->iterations;
    size_t count = NUM_ENTRIES;

    /* regions need to check memory integrity by crc. You can add more regions */

    struct region_crc regions[] = {
        {(const uint8_t *) descriptor->raw_ptr, sizeof(struct mem_raw)}
    };

    if (IS_ENABLED(CONFIG_DEBUG)) {
        for (int j = 0; j < ARRAY_SIZE(regions); j++) {
            printk("crc%d: start - %p, size - 0x%lx, end - %p\n", 
                j, regions[j].ptr, regions[j].size, regions[j].ptr + regions[j].size);
        }
    }

    size_t poison = _current->stack_info.start;

    uint32_t crc_before[ARRAY_SIZE(regions)];
    uint32_t crc_after[ARRAY_SIZE(regions)];

    struct dirty_stride_struct* array_itr = (struct dirty_stride_struct*) descriptor->start_ptr;

    for (; iterations != 0; iterations--) {
        k_mutex_lock(descriptor->mutex, K_FOREVER);
        touch_arr(poison, array_itr, count);

        /* On first iteration we calculate hash summ [after initialization!] */
        if (iterations == descriptor->iterations) {
            calc_crc(crc_before, regions, ARRAY_SIZE(regions));
        }

        /* On last iteration we calculate hash summ [before mutex unlock!] */
        if (iterations == 1) {
            calc_crc(crc_after, regions, ARRAY_SIZE(regions));
        }

        k_mutex_unlock(descriptor->mutex);
    }

    if (IS_ENABLED(CONFIG_DEBUG)) {
        for (int j = 0; j < ARRAY_SIZE(regions); j++) {
            printk("[%d]: before - %d, after - %d, result: %u\n", 
                j, crc_before[j], crc_after[j], crc_before[j] == crc_after[j]);
        }
    }
    for (int j = 0; j < ARRAY_SIZE(regions); j++) {
        *hash_errors += (crc_before[j] != crc_after[j]);
    }
}

void thread_routine(struct mem_descriptor* descriptor, size_t* hash_errors)
{
    uint64_t start_time, stop_time, cycles_spent, milliseconds_spent;
    size_t iterations = ITERATIONS;
    size_t count = NUM_ENTRIES;
    size_t range = descriptor->range;

    if (IS_ENABLED(CONFIG_DEBUG)) {
        printk("Now is %ld cache line max used\n", range / CACHE_LINE);
        printk("stack: start - %p, size - 0x%lx, end - %p\n", 
            (char*) _current->stack_info.start, _current->stack_info.size, 
            (char*) _current->stack_info.start +  _current->stack_info.size);
        printk("array: start - %p, size - 0x%lx, end - %p\n", 
            descriptor->start_ptr, range, descriptor->start_ptr + range);
        printk("Count: %ld, iterations - %ld\n", count, iterations);
    }

    start_time = k_cycle_get_64();
    
    (descriptor->action)(descriptor, hash_errors);

    stop_time = k_cycle_get_64();

    cycles_spent = stop_time - start_time;
    milliseconds_spent = (uint64_t) k_cyc_to_ms_floor64(cycles_spent);

    printk("FINISHED in %lld msec\n", milliseconds_spent);
}
```

## src/modes.h
```c
/*
 * Copyright (C) 2023, Syntacore Ltd.
 *
 * Licensed under the Apache License, Version 2.0 (the "License");
 * you may not use this file except in compliance with the License.
 * You may obtain a copy of the License at
 *     http://www.apache.org/licenses/LICENSE-2.0
 * Unless required by applicable law or agreed to in writing, software
 * distributed under the License is distributed on an "AS IS" BASIS,
 * WITHOUT WARRANTIES OR CONDITIONS OF ANY KIND, either express or implied.
 * See the License for the specific language governing permissions and
 * limitations under the License.
 */
/*
 * @file modes.h
 *
 * @author vdsh-sc
 */

/******************************************************************************
 *                              Defines section
 */

/* * * OPTIONS * * */

/* Also, you can define CONFIG_HEAP_MEM_POOL_SIZE for dynamic memory */

#define LOWER           512
#define ITERATIONS      (1000LLU)

/* We put canaries on the sides of the array - you can adjust their number */
#define CANARIES_ONE_SIDE 2

#define STACK_SIZE (512 * 4 * 4)
#define CACHE_LINE (64)
#define CACHE_SIZE (1024 * 1024) /* L2 or L3 */
#define NUM_THREADS 4

/* * * * * * * * * */

#define HUNDRED_TIMES 100

#define STRIDE CACHE_LINE
#define CACHE_ENTRIES (CACHE_SIZE / CACHE_LINE)

/* We take an array twice as large as the cache + a little more */
#define NUM_ENTRIES (CACHE_ENTRIES * 2 + 1)
#define MAX_RANGE (CACHE_LINE * NUM_ENTRIES)

#define ONE p = (char** volatile) *p;
#define FIVE    ONE ONE ONE ONE ONE
#define TEN     FIVE FIVE
#define FIFTY   TEN TEN TEN TEN TEN
#define HUNDRED FIFTY FIFTY

/******************************************************************************
 *                              Prototypes section
 */

struct mem_raw {
    char left_canary[MAX_RANGE][CANARIES_ONE_SIDE];
    char main_array[MAX_RANGE];
    char right_canary[MAX_RANGE][CANARIES_ONE_SIDE];
};

struct mem_descriptor {
    char*   raw_ptr;    /*!< raw pointer returned by malloc */
    char*   start_ptr;  /*!< start of array, around - canary */
    size_t  range;      /*!< length of array on current step */
    size_t  max_range;  
    size_t  stride;     /*!< often - cache line size */
    struct k_mutex* mutex; /*!< One thread takes full control of 
                                    the memory for the duration of one circle */
    size_t iterations; /*!< num of cycles */
    void (*action) (struct mem_descriptor* descriptor, size_t* hash_errors);
};

struct region_crc {
    const uint8_t * ptr;
    size_t         size;
};

struct __aligned(STRIDE) base_stride_struct {
    struct base_stride_struct* next;
};

struct __aligned(STRIDE) dirty_stride_struct {
    struct base_stride_struct* next;
    uint32_t filler;
    size_t poisoned;
};

void cache_lines_clean(struct mem_descriptor* descriptor, size_t* hash_errors);
void cache_lines_dirty(struct mem_descriptor* descriptor, size_t* hash_errors);
void thread_routine(struct mem_descriptor* descriptor, size_t* hash_errors);
```
