## CMakeLists.txt
```
# Copyright (C) 2025, Syntacore Ltd.
#
# Licensed under the Apache License, Version 2.0 (the "License");
# you may not use this file except in compliance with the License.
# You may obtain a copy of the License at
#     http://www.apache.org/licenses/LICENSE-2.0
# Unless required by applicable law or agreed to in writing, software
# distributed under the License is distributed on an "AS IS" BASIS,
# WITHOUT WARRANTIES OR CONDITIONS OF ANY KIND, either express or implied.
# See the License for the specific language governing permissions and
# limitations under the License.

cmake_minimum_required(VERSION 3.20.0)
find_package(Zephyr REQUIRED HINTS $ENV{ZEPHYR_BASE})
project(game_of_life)

target_sources(app PRIVATE src/main.c src/life.c)
```

## sample.yaml
```
# Copyright (C) 2025, Syntacore Ltd.
#
# Licensed under the Apache License, Version 2.0 (the "License");
# you may not use this file except in compliance with the License.
# You may obtain a copy of the License at
#     http://www.apache.org/licenses/LICENSE-2.0
# Unless required by applicable law or agreed to in writing, software
# distributed under the License is distributed on an "AS IS" BASIS,
# WITHOUT WARRANTIES OR CONDITIONS OF ANY KIND, either express or implied.
# See the License for the specific language governing permissions and
# limitations under the License.

sample:
  name: Game of Life
common:
  extra_args: DEBUG_PRINTF=1
  tags:
    - introduction
    - kernel
  harness: console
  min_ram: 16
  integration_platforms:
    - native_sim
  harness_config:
    type: multi_line
    ordered: false
```

## prj.conf
```kconfig
# Copyright (C) 2025, Syntacore Ltd.
#
# Licensed under the Apache License, Version 2.0 (the "License");
# you may not use this file except in compliance with the License.
# You may obtain a copy of the License at
#     http://www.apache.org/licenses/LICENSE-2.0
# Unless required by applicable law or agreed to in writing, software
# distributed under the License is distributed on an "AS IS" BASIS,
# WITHOUT WARRANTIES OR CONDITIONS OF ANY KIND, either express or implied.
# See the License for the specific language governing permissions and
# limitations under the License.

CONFIG_STDOUT_CONSOLE=n
CONFIG_ASSERT=y
CONFIG_ASSERT_LEVEL=2
CONFIG_NUM_COOP_PRIORITIES=29
CONFIG_NUM_PREEMPT_PRIORITIES=40
CONFIG_PM=y
CONFIG_TICKLESS_KERNEL=y

#CONFIG_MP_MAX_NUM_CPUS=1
#Enable thread awareness for debugging tools supporting it
CONFIG_DEBUG_THREAD_INFO=y
```

## src/main.c
```c
/*
 * Copyright (c) 2011-2016 Wind River Systems, Inc.
 *
 * SPDX-License-Identifier: Apache-2.0
 */

/**
 * @file
 *
 * Game of life, based on https://github.com/andre-j3sus/game-of-life/tree/main
 *
 */

#include <zephyr/kernel.h>

#if defined(CONFIG_STDOUT_CONSOLE)
#include <stdio.h>
#else
#include <zephyr/sys/printk.h>
#endif

#include <zephyr/sys/__assert.h>

#include <zephyr/kernel_version.h>

#include "life.h"

void add_glider_a(int test_world[MAX_ROWS][MAX_COLS], int glider_r, int glider_c) 
{
	set_cell(test_world, glider_r + 0, glider_c + 0, 1);
	set_cell(test_world, glider_r + 0, glider_c + 1, 1);
	set_cell(test_world, glider_r + 0, glider_c + 2, 1);
	set_cell(test_world, glider_r + 1, glider_c + 2, 1);
	set_cell(test_world, glider_r + 2, glider_c + 1, 1);
}

void add_glider_b(int test_world[MAX_ROWS][MAX_COLS], int glider_r, int glider_c) 
{
	set_cell(test_world, glider_r + 0, glider_c + 0, 1);
	set_cell(test_world, glider_r + 1, glider_c + 0, 1);
	set_cell(test_world, glider_r + 2, glider_c + 0, 1);
	set_cell(test_world, glider_r + 2, glider_c + 1, 1);
	set_cell(test_world, glider_r + 1, glider_c + 2, 1);
}

int rule[RULE_SIZE] = {3, 2, 3}; // Default rule

int test_world[MAX_ROWS][MAX_COLS];
int aux_world[MAX_ROWS][MAX_COLS];

#define ESC_CLS "\x1b[2J"
#define ESC_GO_HOME "\x1b[H"
#define ESC_GO_HOME_3_0 "\x1b[3;0H"
#define ESC_INVISIBLE_CURSOR "\x1b[?25l"

int main(void)
{
	
	uint32_t zv = sys_kernel_version_get();

	printk(ESC_CLS);
	printk(ESC_GO_HOME);
	printk(ESC_INVISIBLE_CURSOR);
	printk("Game of life on Zephyr %d.%d.%d\n", SYS_KERNEL_VER_MAJOR(zv), SYS_KERNEL_VER_MINOR(zv), SYS_KERNEL_VER_PATCHLEVEL(zv));


	// Redo test_world
	clear_world(test_world, VIRTUAL_MAX_ROWS, VIRTUAL_MAX_COLS);
	
	//printk("Add gliders\n");
	printk("\n");

	add_glider_a(test_world, 1, 1);
	add_glider_b(test_world, 7, 7);

	uint32_t generation = 1;
	while(1)
	{

		printk(ESC_GO_HOME_3_0);
		printk("\n");
		print_world(test_world, 11, 11);
		printk("Generation: %d\n", generation); generation++;
		k_msleep(1000/12);

		update_world(test_world, 11, 11, aux_world, rule);

		
	}


#ifdef CONFIG_COVERAGE
	/* Wait a few seconds before main() exit, giving the sample the
	 * opportunity to dump some output before coverage data gets emitted
	 */
	k_sleep(K_MSEC(5000));
#endif
	return 0;
}
```

## src/life.c
```c
/*
 * Copyright (C) 2025, Syntacore Ltd.
 *
 * Licensed under the Apache License, Version 2.0 (the "License");
 * you may not use this file except in compliance with the License.
 * You may obtain a copy of the License at
 *     http://www.apache.org/licenses/LICENSE-2.0
 * Unless required by applicable law or agreed to in writing, software
 * distributed under the License is distributed on an "AS IS" BASIS,
 * WITHOUT WARRANTIES OR CONDITIONS OF ANY KIND, either express or implied.
 * See the License for the specific language governing permissions and
 * limitations under the License.
 */

#include <zephyr/kernel.h>

#if defined(CONFIG_STDOUT_CONSOLE)
#include <stdio.h>
#else
#include <zephyr/sys/printk.h>
#endif

#include <zephyr/sys/__assert.h>

#include "life.h"

int cell_lives(const int submatrix[3][3], const int rule[RULE_SIZE])
{
	int cell = submatrix[1][1];
	int live_cells = 0;

	for (int row = 0; row < 3; row++)
	{
		for (int col = 0; col < 3; col++)
		{
			if (col == 1 && row == 1)
				continue;

			live_cells += submatrix[row][col];
		}
	}

	return (cell == 1 && (live_cells >= rule[1] && live_cells <= rule[0])) ||
		   (cell == 0 && live_cells == rule[2]);
}

void clear_world(int world[][MAX_COLS], int rows_count, int cols_count)
{
	if (cols_count > VIRTUAL_MAX_COLS || rows_count < 2 || cols_count < 2)
		return;

	for (size_t row = 1; row < rows_count + 1; row++)
	{
		for (size_t col = 1; col < cols_count + 1; col++)
		{
			world[row][col] = 0;
		}
	}
}

void set_cell(int world[][MAX_COLS], int row, int col, int value)
{
	world[row][col] = value;
}

int get_cell(const int world[][MAX_COLS], int row, int col)
{
	return world[row][col];
}

void copy_world(
	int world1[][MAX_COLS], int rows_count, int cols_count,
	int world2[][MAX_COLS])
{
	for (size_t row = 1; row < rows_count + 1; row++)
	{
		for (size_t col = 1; col < cols_count + 1; col++)
		{
			world1[row][col] = world2[row][col];
		}
	}
}

void update_world(
	int world[][MAX_COLS],
	int rows_count, int cols_count,
	int world_aux[][MAX_COLS], const int rule[RULE_SIZE])
{
	for (size_t row = 1; row < rows_count + 1; row++)
	{
		for (size_t col = 1; col < cols_count + 1; col++)
		{
			int pre_row = row - 1;
			if (pre_row == 0)
				pre_row = rows_count;

			int pos_row = row + 1;
			if (pos_row == rows_count + 1)
				pos_row = 1;

			int pre_col = col - 1;
			if (pre_col == 0)
				pre_col = cols_count;

			int pos_col = col + 1;
			if (pos_col == cols_count + 1)
				pos_col = 1;

			int submatrix[3][3];
			submatrix[0][0] = get_cell(world, pre_row, pre_col);
			submatrix[0][1] = get_cell(world, pre_row, col);
			submatrix[0][2] = get_cell(world, pre_row, pos_col);
			submatrix[1][0] = get_cell(world, row, pre_col);
			submatrix[1][1] = get_cell(world, row, col);
			submatrix[1][2] = get_cell(world, row, pos_col);
			submatrix[2][0] = get_cell(world, pos_row, pre_col);
			submatrix[2][1] = get_cell(world, pos_row, col);
			submatrix[2][2] = get_cell(world, pos_row, pos_col);

			set_cell(world_aux, row, col, cell_lives(submatrix, rule));
		}
	}

	copy_world(world, rows_count, cols_count, world_aux);
}

void update_world_n_generations(
	int n, int world[][MAX_COLS],
	int rows_count, int cols_count,
	int world_aux[][MAX_COLS],
	const int rule[RULE_SIZE])
{
	if (n <= 0)
		return;

	for (size_t i = 0; i <= n; i++)
	{
		update_world(world, rows_count, cols_count, world_aux, rule);
	}
}
#if COLOR_PRINTS
void print_world(const int world[][MAX_COLS], int rows_count, int cols_count)
{
	static int color_idx = 0;
	static const int color_idx_max = 8;
	//static char life_syms[] = {'*', 'x', 'X', 'O', 'o', 'Y', 'H', 'T', 'Z', 'z', 'c', 'C', 'v', 'V', 'N', 'w', 'W', 'M'};
	static char life_syms[] = {'*', 'x', 'X', 'O', 'o', '.'};
	static int life_syms_idx = 0;
	static const int life_syms_idx_max = (int)(sizeof(life_syms) / sizeof(life_syms[0]));
	for (size_t row = 1; row < rows_count + 1; row++)
	{
		for (size_t col = 1; col < cols_count + 1; col++)
		{
			if(world[row][col])
			{
				printk("\x1b[1;%dm%c ", color_idx + 30, life_syms[life_syms_idx]);
				life_syms_idx = (life_syms_idx + 1) % life_syms_idx_max;
				color_idx = (color_idx + 1) % color_idx_max;
			}
			else printk("\x1b[0m  ");
		}
		printk("\x1b[0m\n");
	}
}
#else 
void print_world(const int world[][MAX_COLS], int rows_count, int cols_count)
{
	for (size_t row = 1; row < rows_count + 1; row++)
	{
		for (size_t col = 1; col < cols_count + 1; col++)
		{
			//putchar((world[row][col]) ? "X " : ". ");
			// putchar((world[row][col]) ? 'X' : '.');
			// putchar(' ');
			printk("%c ", (world[row][col]) ? 'X' : '.');
		}
		printk("\n");
	}
}
#endif 
```

## src/life.h
```c
/*
 * Copyright (C) 2025, Syntacore Ltd.
 *
 * Licensed under the Apache License, Version 2.0 (the "License");
 * you may not use this file except in compliance with the License.
 * You may obtain a copy of the License at
 *     http://www.apache.org/licenses/LICENSE-2.0
 * Unless required by applicable law or agreed to in writing, software
 * distributed under the License is distributed on an "AS IS" BASIS,
 * WITHOUT WARRANTIES OR CONDITIONS OF ANY KIND, either express or implied.
 * See the License for the specific language governing permissions and
 * limitations under the License.
 */

#pragma once

#include <stdio.h>

#define COLOR_PRINTS 1

#define RULE_SIZE 3
#define VIRTUAL_MAX_ROWS 11
#define VIRTUAL_MAX_COLS 11
#define MAX_COLS (VIRTUAL_MAX_COLS + 2)
#define MAX_ROWS (VIRTUAL_MAX_ROWS + 2)
#define FILE_MAX_LINES 27

// More about game of life: https://en.wikipedia.org/wiki/Conway%27s_Game_of_Life

/*
 * Function: cell_lives
 * ----------------------------
 * Checks if the center cell lives in the next generation:
 * 
 * Any live cell with:
 *  - more than "maxNeighbors" neighbors dies -> overpopulation
 *  - fewer than "minNeighbors" neighbors dies -> underpopulation
 *  - otherwise, lives
 * 
 * Any dead cell with exactly "neighborsToBorn" neighbors becomes a live cell -> reproduction
 *
 * submatrix: 3x3 matrix of 0s and 1s
 * rule: life game rule -> {maxNeighbors, minNeighbors, neighborsToBorn}
 *
 * returns: 1 (true) if the cell lives in the next generation; otherwise returns 0 (false)
 */
int cell_lives(const int submatrix[3][3], const int rule[RULE_SIZE]);

/*
 * Function: clear_world
 * ----------------------------
 * Initializes a world with dead cells and size rows_count x cols_count.
 *
 * world: (rows_count + 2) x (cols_count + 2) matrix of 0s and 1s
 * rows_count: number of rows
 * cols_count: number of columns
 */
void clear_world(int world[][MAX_COLS], int rows_count, int cols_count);

/*
 * Function: set_cell
 * ----------------------------
 * Sets the value to the cell.
 *
 * world: matrix of 0s and 1s
 * row: cell row
 * col: cell column
 * value: value to set
 */
void set_cell(int world[][MAX_COLS], int row, int col, int value);

/*
 * Function: get_cell
 * ----------------------------
 * Gets the cell value.
 *
 * world: matrix of 0s and 1s
 * row: cell row
 * col: cell column
 */
int get_cell(const int world[][MAX_COLS], int row, int col);

/*
 * Function: copy_world
 * ----------------------------
 * Copies the world2 to the world1.
 * 
 * world1: matrix of 0s and 1s
 * rows_count: number of rows
 * cols_count: number of columns
 * world2: world to copy
 */
void copy_world(
	int world1[][MAX_COLS], int rows_count, int cols_count,
	int world2[][MAX_COLS]);

/*
 * Function: update_world
 * ----------------------------
 * Updates the world.
 * 
 * Boundary conditions:
 *  world[i][cols_count + 1]    -> world[i][1]
 *  world[i][0]                 -> world[i][cols_count]
 *  world[rows_count + 1][j]    -> world[1][j]
 *  world[0][j]                 -> world[rows_count][j]
 *
 * world: matrix of 0s and 1s
 * rows_count: number of rows
 * cols_count: number of columns
 * world_aux: auxiliary world
 * rule: life game rule -> {maxNeighbors, minNeighbors, neighborsToBorn}
 */
void update_world(
	int world[][MAX_COLS], int rows_count, int cols_count,
	int world_aux[][MAX_COLS], const int rule[RULE_SIZE]);

/*
 * Function: update_world_n_generations
 * ----------------------------
 * Updates the world n generations.
 *
 * n: number of generations to update
 * world: matrix of 0s and 1s
 * rows_count: number of rows
 * cols_count: number of columns
 * world_aux: auxiliary world
 * rule: life game rule -> {maxNeighbors, minNeighbors, neighborsToBorn}
 */
void update_world_n_generations(
	int n, int world[][MAX_COLS], int rows_count, int cols_count,
	int world_aux[][MAX_COLS], const int rule[RULE_SIZE]);


/*
 * Function: print_world
 * ----------------------------
 * Shows the world in the standart output.
 * 
 * - dead cell (0) is represented by ". "
 * - live cell (1) is represented by "X "
 *
 * world: matrix of 0s and 1s
 * rows_count: number of rows
 * cols_count: number of columns
 */
void print_world(const int world[][MAX_COLS], int rows_count, int cols_count);
```
