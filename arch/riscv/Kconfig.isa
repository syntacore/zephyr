## arch/riscv/Kconfig.isa
```kconfig
# Copyright (c) 2022 Carlo Caione <ccaione@baylibre.com>
# SPDX-License-Identifier: Apache-2.0

config RISCV_ISA_RV32I
	bool
	help
	  RV32I Base Integer Instruction Set - 32bit

config RISCV_ISA_RV32E
	bool
	help
	  RV32E Base Integer Instruction Set (Embedded) - 32bit

config RISCV_ISA_RV64I
	bool
	select 64BIT
	help
	  RV64I Base Integer Instruction Set - 64bit

config RISCV_ISA_RV128I
	bool
	help
	  RV128I Base Integer Instruction Set - 128bit

config RISCV_ISA_EXT_M
	bool
	help
	  (M) - Standard Extension for Integer Multiplication and Division

	  Standard integer multiplication and division instruction extension,
	  which is named "M" and contains instructions that multiply or divide
	  values held in two integer registers.

config RISCV_ISA_EXT_A
	bool
	imply RISCV_ISA_EXT_ZAAMO
	imply RISCV_ISA_EXT_ZALRSC
	help
	  (A) - Standard Extension for Atomic Instructions

	  The standard atomic instruction extension is denoted by instruction
	  subset name "A", and contains instructions that atomically
	  read-modify-write memory to support synchronization between multiple
	  RISC-V threads running in the same memory space.

config RISCV_ISA_EXT_F
	bool
	select CPU_HAS_FPU
	help
	  (F) - Standard Extension for Single-Precision Floating-Point

	  Standard instruction-set extension for single-precision
	  floating-point, which is named "F" and adds single-precision
	  floating-point computational instructions compliant with the IEEE
	  754-2008 arithmetic standard.

config RISCV_ISA_EXT_D
	bool
	depends on RISCV_ISA_EXT_F
	select CPU_HAS_FPU_DOUBLE_PRECISION
	help
	  (D) - Standard Extension for Double-Precision Floating-Point

	  Standard double-precision floating-point instruction-set extension,
	  which is named "D" and adds double-precision floating-point
	  computational instructions compliant with the IEEE 754-2008
	  arithmetic standard.

config RISCV_ISA_EXT_G
	bool
	select RISCV_ISA_EXT_M
	select RISCV_ISA_EXT_A
	select RISCV_ISA_EXT_F
	select RISCV_ISA_EXT_D
	select RISCV_ISA_EXT_ZICSR
	select RISCV_ISA_EXT_ZIFENCEI
	help
	  (IMAFDZicsr_Zifencei) IMAFDZicsr_Zifencei extensions

config RISCV_ISA_EXT_Q
	bool
	depends on RISCV_ISA_RV64I
	depends on RISCV_ISA_EXT_F
	depends on RISCV_ISA_EXT_D
	help
	  (Q) - Standard Extension for Quad-Precision Floating-Point

	  Standard extension for 128-bit binary floating-point instructions
	  compliant with the IEEE 754-2008 arithmetic standard. The 128-bit or
	  quad-precision binary floatingpoint instruction subset is named "Q".

config RISCV_ISA_EXT_C
	bool
	select RISCV_ISA_EXT_ZCA
	select RISCV_ISA_EXT_ZCD if RISCV_ISA_EXT_D
	select RISCV_ISA_EXT_ZCF if RISCV_ISA_EXT_F && (RISCV_ISA_RV32I || RISCV_ISA_RV32E)
	help
	  (C) - Standard Extension for Compressed Instructions

	  RISC-V standard compressed instruction set extension, named "C",
	  which reduces static and dynamic code size by adding short 16-bit
	  instruction encodings for common operations.

config RISCV_ISA_EXT_ZICNTR
	bool
	depends on RISCV_ISA_EXT_ZICSR
	help
	  (Zicntr) - Standard Extension for Base Counters and Timers

	  The Zicntr standard extension comprises the three counters (CYCLE, TIME, and INSTRET),
	  which have dedicated functions (cycle count, real-time clock and instructions retired,
	  respectively).

config RISCV_ISA_EXT_ZICSR
	bool
	help
	  (Zicsr) - Standard Extension for Control and Status Register (CSR) Instructions

	  The "Zicsr" extension introduces support for the full set of CSR
	  instructions that operate on CSRs registers.

config RISCV_ISA_EXT_ZIFENCEI
	bool
	help
	  (Zifencei) - Standard Extension for Instruction-Fetch Fence

	  The "Zifencei" extension includes the FENCE.I instruction that
	  provides explicit synchronization between writes to instruction
	  memory and instruction fetches on the same hart.

config RISCV_ISA_EXT_ZAAMO
	bool
	help
	  (Zaamo) - Atomic memory operation subset of the A extension

	  The Zaamo extension enables support for AMO*.W/D-style instructions.

config RISCV_ISA_EXT_ZALRSC
	bool
	help
	  (Zalrsc) - Load-Reserved/Store-Conditional subset of the A extension

	  The Zalrsc extension enables support for LR.W/D and SC.W/D-style instructions.

config RISCV_ISA_EXT_ZCA
	bool
	help
	  (Zca) - Zba Extension for Compressed Instructions

	  The Zca extension is a subset of the C extension that does not include
	  the floating-point load and store instructions.

config RISCV_ISA_EXT_ZCB
	bool
	depends on RISCV_ISA_EXT_ZCA
	help
	  (Zcb) - Zcb Extension for Simple Compressed Instructions

	  The Zcb extension is a set of simple code-size saving instructions
	  which are easy to implement on all CPUs.

config RISCV_ISA_EXT_ZCD
	bool
	depends on RISCV_ISA_EXT_D
	depends on RISCV_ISA_EXT_ZCA
	help
	  (Zcd) - Zcd Extension for Double-Precision FP Compressed Instructions

	  The Zcd extension consists of compressed double-precision
	  floating-point load and store instructions.

config RISCV_ISA_EXT_ZCF
	bool
	depends on RISCV_ISA_RV32I || RISCV_ISA_RV32E
	depends on RISCV_ISA_EXT_F
	depends on RISCV_ISA_EXT_ZCA
	help
	  (Zcf) - Zcf Extension for Single-Precision FP Compressed Instructions

	  The Zcf extension consists of compressed single-precision
	  floating-point load and store instructions.

config RISCV_ISA_EXT_ZCMP
	bool
	depends on RISCV_ISA_EXT_ZCA
	depends on !RISCV_ISA_EXT_ZCD
	help
	  (Zcmp) - Zcmp Extension for Complex Compressed Instructions

	  The Zcmp extension consists of complex operations intended for
	  embedded CPUs.

config RISCV_ISA_EXT_ZCMT
	bool
	depends on RISCV_ISA_EXT_ZICSR
	depends on RISCV_ISA_EXT_ZCA
	depends on !RISCV_ISA_EXT_ZCD
	help
	  (Zcmt) - Zcmt Extension for Compressed Table Jump Instructions

	  The Zcmt extension consists of compressed table jump instructions for
	  embedded CPUs.

config RISCV_ISA_EXT_ZBA
	bool
	help
	  (Zba) - Zba BitManip Extension

	  The Zba instructions can be used to accelerate the generation of
	  addresses that index into arrays of basic types (halfword, word,
	  doubleword) using both unsigned word-sized and XLEN-sized indices: a
	  shifted index is added to a base address.

config RISCV_ISA_EXT_ZBB
	bool
	help
	  (Zbb) - Zbb BitManip Extension (Basic bit-manipulation)

	  The Zbb instructions can be used for basic bit-manipulation (logical
	  with negate, count leading / trailing zero bits, count population,
	  etc...).

config RISCV_ISA_EXT_ZBC
	bool
	help
	  (Zbc) - Zbc BitManip Extension (Carry-less multiplication)

	  The Zbc instructions can be used for carry-less multiplication that
	  is the multiplication in the polynomial ring over GF(2).

config RISCV_ISA_EXT_ZBS
	bool
	help
	  (Zbs) - Zbs BitManip Extension (Single-bit instructions)

	  The Zbs instructions can be used for single-bit instructions that
	  provide a mechanism to set, clear, invert, or extract a single bit in
	  a register.

config RISCV_ISA_EXT_ZMMUL
	bool
	help
	  (Zmmul) - Zmmul Extension for Integer Multiplication

	  The Zmmul extension implements the multiplication subset of the M
	  extension.

config RISCV_ISA_EXT_ZBKB
	bool
	help
	  (Zbkb) - Bitmanip instructions for Scalar Crypto Extension

	  This extension is a subset of the Bitmanipulation Extension Zbb which 
	  is particularly useful for Cryptography.

config RISCV_ISA_EXT_ZBKC
	bool
	help
	  (Zbkc) - Carry-less multiply instructions of Scalar Crypto Extension

	  Constant time carry-less multiply for Galois/Counter Mode. These instructions
	  are separated from the Zbkb because they have a considerable implementation 
	  overhead which cannot be amortised across other instructions.

config RISCV_ISA_EXT_ZBKX
	bool
	help
	  (Zbkx) - Crossbar permutation instructions of Scalar Crypto Extension

	  These instructions are useful for implementing SBoxes in constant time, 
	  and potentially with DPA protections. These are 
	  separated from the Zbkb because they have a considerable implementation 
	  overhead which cannot be amortised across other instructions.

config RISCV_ISA_EXT_ZKNE
	bool
	help
	  (Zkne) - NIST Suite: AES Encryption of Scalar Crypto Extension

	  Instructions for accelerating the encryption and key-schedule functions 
	  of the AES block cipher.

config RISCV_ISA_EXT_ZKND
	bool
	help
	  (Zknd) - NIST Suite: AES Decryption of Scalar Crypto Extension

	  Instructions for accelerating the decryption and key-schedule functions 
	  of the AES block cipher.

config RISCV_ISA_EXT_ZKNH
	bool
	help
	  (Zknh) - NIST Suite: Hash Function Instructions of Scalar Crypto Extension

	  Instructions for accelerating the SHA2 family of cryptographic hash functions

config RISCV_ISA_EXT_ZKN
	bool
	select RISCV_ISA_EXT_ZBKB
	select RISCV_ISA_EXT_ZBKC
	select RISCV_ISA_EXT_ZBKX
	select RISCV_ISA_EXT_ZKNE
	select RISCV_ISA_EXT_ZKND
	select RISCV_ISA_EXT_ZKNH
	help
	  (Zkn) - NIST Algorithm Suite of Scalar Crypto Extension

	  This extension is shorthand for the following set of other extensions:
	  Zbkb, Zbkc, Zbkx, Zkne, Zknd, Zknh

config RISCV_ISA_EXT_ZKSED
	bool
	help
	  (Zksed) - ShangMi Suite: SM4 Block Cipher Instructions of Scalar Crypto Extension

	  Instructions for accelerating the SM4 Block Cipher. Note that unlike AES, 
	  this cipher uses the same core operation for encryption and decryption, 
	  hence there is only one extension for it.

config RISCV_ISA_EXT_ZKSH
	bool
	help
	  (Zksh) - ShangMi Suite: SM3 Hash Function Instructions of Scalar Crypto Extension

	  Instructions for accelerating the SM3 hash function.

config RISCV_ISA_EXT_ZKT
	bool
	help
	  (Zkt) - Data Independent Execution Latency Subset of Scalar Crypto Extension

	  The Zkt extension attests that the machine has data-independent execution time 
	  for a safe subset of instructions. This property is commonly called 
	  "constant-time" although should not be taken with that literal meaning.

	  All currently proposed cryptographic instructions (scalar K extension) 
	  are on this list, together with a set of relevant supporting instructions 
	  from I, M, C, and B extensions. Zkt does not define a set of instructions 
	  available in the core; it just restricts the behaviour of certain instructions 
	  if those are implemented, so that they do not leak information about processed 
	  secret data (plaintext, keying information, etc) through differences 
	  in execution latency.
	  
config RISCV_ISA_EXT_ZICBOM
	bool
	help
	  (Zicbom) - Extension for cache-block management instructions

	  The Zicbom extension defines a set of cache-block management instructions: 
	  CBO.INVAL, CBO.CLEAN, and CBO.FLUSH
```

## arch/riscv/custom/Kconfig
```kconfig
# Copyright (c) 2025 Andes Technology Corporation
# SPDX-License-Identifier: Apache-2.0

if DT_HAS_ANDESTECH_ANDESCORE_V5_ENABLED

rsource "andes/Kconfig"

endif # DT_HAS_ANDESTECH_ANDESCORE_V5_ENABLED

if DT_HAS_XUANTIE_E907_ENABLED

rsource "thead/Kconfig"
rsource "thead/Kconfig.core"

endif # DT_HAS_XUANTIE_E907_ENABLED

if DT_HAS_SYNTACORE_SCR1_ENABLED

rsource "syntacore/scr1/Kconfig"

endif # DT_HAS_SYNTACORE_SCR1_ENABLED

if DT_HAS_SYNTACORE_SCR3_ENABLED

rsource "syntacore/scr3/Kconfig"

endif # DT_HAS_SYNTACORE_SCR3_ENABLED

if DT_HAS_SYNTACORE_SCR4_ENABLED

rsource "syntacore/scr4/Kconfig"

endif # DT_HAS_SYNTACORE_SCR4_ENABLED

if DT_HAS_SYNTACORE_SCR5_ENABLED

rsource "syntacore/scr5/Kconfig"

endif # DT_HAS_SYNTACORE_SCR5_ENABLED

if DT_HAS_SYNTACORE_SCR6_ENABLED

rsource "syntacore/scr6/Kconfig"

endif # DT_HAS_SYNTACORE_SCR6_ENABLED

if DT_HAS_SYNTACORE_SCR7_ENABLED

rsource "syntacore/scr7/Kconfig"

endif # DT_HAS_SYNTACORE_SCR7_ENABLED

if DT_HAS_SYNTACORE_SCR9_ENABLED

rsource "syntacore/scr9/Kconfig"

endif # DT_HAS_SYNTACORE_SCR9_ENABLED
```

## boards/riscv/scr7_l2/Kconfig.board
```kconfig
config BOARD_SCR7_L2
	bool "SCR7 L2 evaluation board"
	depends on SOC_RISCV64_SCR7_L2
```

## boards/riscv/scr7_l2/scr7_l2_defconfig
```kconfig
CONFIG_SOC_SERIES_RISCV64_SCR7=y
CONFIG_SOC_RISCV64_SCR7_L2=y
CONFIG_BOARD_SCR7_L2=y
CONFIG_LINKER_SORT_BY_ALIGNMENT=n
CONFIG_XIP=n
CONFIG_INCLUDE_RESET_VECTOR=y
CONFIG_CONSOLE=y
CONFIG_PRINTK=y
CONFIG_SERIAL=y
CONFIG_UART_CONSOLE=y
CONFIG_RISCV_MACHINE_TIMER=y
CONFIG_BOOT_BANNER=y
CONFIG_RISCV_PMP=y
CONFIG_PMP_SLOTS=16
CONFIG_SMP=y
CONFIG_MP_MAX_NUM_CPUS=2
```

## boards/riscv/vcu118_scr7/vcu118_scr7_defconfig
```kconfig
CONFIG_SOC_SERIES_RISCV64_SCR7=y
CONFIG_SOC_RISCV64_SCR7=y
CONFIG_BOARD_VCU118_SCR7=y
CONFIG_LINKER_SORT_BY_ALIGNMENT=n
CONFIG_XIP=n
CONFIG_INCLUDE_RESET_VECTOR=y
CONFIG_CONSOLE=y
CONFIG_PRINTK=y
CONFIG_SERIAL=y
CONFIG_UART_CONSOLE=y
CONFIG_RISCV_MACHINE_TIMER=y
CONFIG_BOOT_BANNER=y
CONFIG_SMP=y
CONFIG_MP_MAX_NUM_CPUS=4
```

## dts/bindings/cache/scr,cache.yaml
```yaml
description: Cache properties for Syntacore platforms

compatible: "scr,cache"

properties:
  d-cache-line-size:
    type: int
    required: true
    description: Data Cache line size

  d-cache-size:
    type: int
    required: true
    description: Data Cache size

  i-cache-line-size:
    type: int
    required: true
    description: Instruction Cache line size

  i-cache-size:
    type: int
    required: true
    description: Instruction Cache size
```

## dts/bindings/timer/syntacore,machine-timer.yaml
```yaml
# Copyright (c) Syntacore 2024. All rights reserved.

# SPDX-License-Identifier: Apache-2.0

description: |
  Syntacore Machine Timer

  The Syntacore machine timer provides RISC-V privileged mtime and mtimecmp
  registers.

compatible: "syntacore,machine-timer"

include: "riscv,machine-timer.yaml"
```

## soc/riscv/riscv-privileged/syntacore-scr/Kconfig.soc
```kconfig
# riscv SOC series supporting the riscv privileged architecture spec

# Copyright (c) 2022 Syntacore
# SPDX-License-Identifier: Apache-2.0

menuconfig SYNTACORE_SCR
	bool "Syntacore-specific SoC options"
	depends on SOC_FAMILY_RISCV_PRIVILEGED
	
if SYNTACORE_SCR

config SCR_SYSTEM_HALT
	bool "Syntacore custom system halt handler"
	help
		This option enables Syntacore custom system halt handler

config SCR_SYSTEM_HALT_REASON_OFFSET
	int "Syntacore system halt reason offset"
	depends on SCR_SYSTEM_HALT
	default 0
	help
		This option configures an offset which is applied to
		any halt reason number passed by Zephyr to arch_system_halt.
		This may be useful to shift Zephyr's halt numbers range

config SCR_L1_CACHE
	bool
	help
		This option enables Syntacore L1 cache

config SCR_L2_CACHE
	bool
	help
		This option enables Syntacore L2 cache

config SCR_L3_CACHE
	bool
	help
		This option enables Syntacore L3 cache

config SCR_L1D_PREFETCHER
	bool "Syntacore L1D prefetcher"
	depends on SCR_L1_CACHE
	help
		This option signals Syntacore L1D prefetcher presence
		
config SCR_L1D_PREFETCHER_ENABLED
	bool "Enable Syntacore L1D prefetcher"
	depends on SCR_L1D_PREFETCHER
	default y
	help
		This option enables or disables Syntacore L1D prefetcher

config SCR_MPU
	bool
	help
		This option enables Syntacore Memory Protection Unit
		
config SCR_MMU
	bool "Syntacore MMU"
	help
		This option enables Syntacore Memory Management Unit
		
config SCR_MRT
	bool
	help
		This option enables Syntacore Memory Routing Table
		
config SCR_PMP_ADDR_SANITIZER
	bool "PMP memory check"
	depends on RISCV_PMP
	help
		This option enables address sanitizer which triggers 
		exception on unused memory access or on writing RO data

source "soc/riscv/riscv-privileged/syntacore-scr/*/Kconfig.soc"

endif #SYNTACORE_SCR
```

## soc/riscv/riscv-privileged/syntacore-scr/scr1/Kconfig.defconfig.series
```kconfig
if SOC_SERIES_RISCV32_SCR1

config SOC_SERIES
	default "scr1"

config SYS_CLOCK_HW_CYCLES_PER_SEC
	default 90000000

config RISCV_SOC_INTERRUPT_INIT
	default y

config RISCV_HAS_CPU_IDLE
	default y

config 2ND_LVL_ISR_TBL_OFFSET
	default 12

config 2ND_LVL_INTR_00_OFFSET
	default 11

config NUM_IRQS
	default 32
	
config MINIMAL_LIBC_OPTIMIZE_STRING_FOR_SIZE
	default n
	
config RISCV_TRAP_HANDLER_ALIGNMENT
	default 64

endif # SOC_SERIES_RISCV32_SCR1
```
