## soc/riscv/riscv-privileged/syntacore-scr/scr1/Kconfig.series
```kconfig
# Kconfig - RISCV32_SCR1 SoC implementation
#
# Copyright (C) Syntacore 2017-2023. All rights reserved.
#
# SPDX-License-Identifier: Apache-2.0
#

config SOC_SERIES_RISCV32_SCR1
	bool "Syntacore SCR1-based SoC implementation"
	select RISCV
	select SOC_FAMILY_RISCV_PRIVILEGED
	select ATOMIC_OPERATIONS_C
	select RISCV_ISA_EXT_M
	select RISCV_ISA_EXT_A
	select RISCV_ISA_EXT_C
	select RISCV_ISA_EXT_ZICSR
	select RISCV_ISA_EXT_ZIFENCEI
	select SYNTACORE_SCR
	select SCR_IPIC
	help
		Enable support for Syntacore SCR1-based SoC
```
